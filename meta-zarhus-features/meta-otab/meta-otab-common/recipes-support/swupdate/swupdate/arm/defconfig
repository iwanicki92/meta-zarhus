## meta-zarhus-features/meta-otab/meta-otab-uboot/conf/layer.conf
```bitbake
# We have a conf and classes directory, add to BBPATH
BBPATH .= ":${LAYERDIR}"

# We have recipes-* directories, add to BBFILES
BBFILES += "${LAYERDIR}/recipes-*/*/*.bb ${LAYERDIR}/recipes-*/*/*.bbappend"
BBFILES_DYNAMIC += " \
    raspberrypi:${LAYERDIR}/dynamic-layers/raspberrypi/recipes-*/*/*.bb \
    raspberrypi:${LAYERDIR}/dynamic-layers/raspberrypi/recipes-*/*/*.bbappend \
    sunxi:${LAYERDIR}/dynamic-layers/sunxi/recipes-*/*/*.bb \
    sunxi:${LAYERDIR}/dynamic-layers/sunxi/recipes-*/*/*.bbappend \
"

BBFILES_DYNAMIC += " \
    raspberrypi:${LAYERDIR}/dynamic-layers/raspberrypi/recipes-*/*/*.bb \
    raspberrypi:${LAYERDIR}/dynamic-layers/raspberrypi/recipes-*/*/*.bbappend \
"

BBFILE_COLLECTIONS += "otab-uboot"
BBFILE_PATTERN_otab-uboot = "^${LAYERDIR}/"
BBFILE_PRIORITY_otab-uboot = "12"

# This should only be incremented on significant changes that will
# cause compatibility issues with other layers
LAYERVERSION_otab-uboot = "1"

LAYERDEPENDS_otab-uboot = " \
    otab-common \
    core \
    openembedded-layer \
    swupdate \
    "

LAYERSERIES_COMPAT_otab-uboot = "honister kirkstone mickledore master"

##################################################
# OTAB variables
##################################################

OTAB_KERNEL_IMAGE_TYPE ?= "${KERNEL_IMAGETYPE}-initramfs"

WKS_FILE:rpi = "otab-uboot-rpi.wks.in"
WKS_FILE:lamobo-r1 = "otab-uboot-lamobo-r1.wks.in"

##################################################
# RPi config
##################################################
IMAGE_BOOT_FILES:remove = "${KERNEL_IMAGETYPE}"
IMAGE_BOOT_FILES:append = " \
    ${OTAB_KERNEL_IMAGE_TYPE}-${MACHINE}.bin;${OTAB_KERNEL_IMAGE_TYPE}-a \
    ${OTAB_KERNEL_IMAGE_TYPE}-${MACHINE}.bin;${OTAB_KERNEL_IMAGE_TYPE}-b \
    "
```
